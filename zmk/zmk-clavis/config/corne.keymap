
#define MIRYOKU_ALPHAS_QWERTY
#include "corne.h"
#include "../miryoku/miryoku.dtsi"




// used qmk-to-zmk.html to convert qmk json format to zmk
// show with https://nickcoutsos.github.io/keymap-editor/

/*

#include <behaviors.dtsi>
#include <dt-bindings/zmk/keys.h>
#include <dt-bindings/zmk/bt.h>
#include <dt-bindings/zmk/ext_power.h>
#include <dt-bindings/zmk/rgb.h>
#define ZMK_POINTING_DEFAULT_MOVE_VAL 600  // default: 600
#define ZMK_POINTING_DEFAULT_SCRL_VAL 10    // default: 10
#include <dt-bindings/zmk/pointing.h>

/ {
  keymap {
    compatible = "zmk,keymap";

layer0 {
          bindings = <
          &kp Q &kp W &kp E &kp R &kp T &kp Y &kp U &kp I &kp O &kp P &mt LEFT_GUI A &mt LEFT_ALT S &mt LEFT_CONTROL D &mt LEFT_SHIFT F &kp G &kp H &mt LEFT_SHIFT J &mt LEFT_CONTROL K &mt LEFT_ALT L &mt LEFT_GUI SEMICOLON &lt 1 Z &mt RIGHT_ALT X &kp C &kp V &kp B &kp N &kp M &kp COMMA &mt RIGHT_ALT DOT &lt 1 SLASH &lt 3 ESCAPE &lt 1 SPACE &lt 2 TAB &lt 5 ENTER &lt 4 BACKSPACE &lt 6 DELETE
          >;
        };
layer1 {
          bindings = <
          &sys_reset &none &none &none &none &kp K_AGAIN &kp K_UNDO &kp LS(DELETE) &kp LC(INSERT) &kp LS(INSERT) &kp LEFT_GUI &kp LEFT_ALT &kp LEFT_CONTROL &kp LEFT_SHIFT &none &kp CAPSLOCK &kp LEFT &kp DOWN &kp UP &kp RIGHT &none &kp LC(X) &kp LC(C) &kp LC(V) &none &kp INSERT &kp HOME &kp PAGE_DOWN &kp PAGE_UP &kp END &none &none &none &kp ENTER &kp BACKSPACE &kp DELETE
          >;
        };
layer2 {
          bindings = <
          &sys_reset &none &none &none &none &none &none &none &none &none &kp LEFT_GUI &kp LEFT_ALT &kp LEFT_CONTROL &kp LEFT_SHIFT &none &none &mmv MOVE_LEFT &mmv MOVE_DOWN &mmv MOVE_UP &mmv MOVE_RIGHT &none &kp RIGHT_ALT &none &none &none &none &msc SCRL_LEFT &msc SCRL_DOWN &msc SCRL_UP &msc SCRL_RIGHT &none &none &none &mkp MB2 &mkp MB1 &mkp MB3
          >;
        };
layer3 {
          bindings = <
          &none &kp KP_N7 &kp KP_N8 &kp KP_N9 &none &rgb_ug RGB_TOG &rgb_ug RGB_EFF &rgb_ug RGB_HUI &rgb_ug RGB_SAI &rgb_ug RGB_BRI &none &kp KP_N4 &kp KP_N5 &kp KP_N6 &none &none &kp C_PREVIOUS &kp C_VOLUME_DOWN &kp C_VOLUME_UP &kp C_NEXT &kp KP_N0 &kp KP_N1 &kp KP_N2 &kp KP_N3 &kp KP_DOT &none &none &none &none &sys_reset &none &none &none &kp C_STOP &kp C_PLAY_PAUSE &kp C_MUTE
          >;
        };
layer4 {
          bindings = <
          &kp LEFT_BRACKET &kp N7 &kp N8 &kp N9 &kp RIGHT_BRACKET &none &none &none &none &sys_reset &kp SINGLE_QUOTE &kp N4 &kp N5 &kp N6 &kp EQUAL &none &kp LEFT_SHIFT &kp LEFT_CONTROL &kp LEFT_ALT &kp LEFT_GUI &kp GRAVE &kp N1 &kp N2 &kp N3 &kp BACKSLASH &none &kp RA(SINGLE_QUOTE) &kp RS(LA(SINGLE_QUOTE)) &kp RIGHT_ALT &none &kp DOT &kp N0 &kp MINUS &none &none &none
          >;
        };
layer5 {
          bindings = <
          &kp LEFT_BRACE &kp AMPERSAND &kp ASTERISK &kp LEFT_PARENTHESIS &kp RBRC &none &none &none &none &sys_reset &kp COLON &kp DOLLAR &kp PERCENT &kp CARET &kp PLUS &none &kp LEFT_SHIFT &kp LEFT_CONTROL &kp LEFT_ALT &kp LEFT_GUI &kp TILDE &kp EXCLAMATION &kp AT &kp HASH &kp PIPE &none &none &none &kp RIGHT_ALT &none &kp LEFT_PARENTHESIS &kp RIGHT_PARENTHESIS &kp UNDERSCORE &none &none &none
          >;
        };
layer6 {
          bindings = <
          &kp F12 &kp F7 &kp F8 &kp F9 &kp PRINTSCREEN &none &none &none &none &sys_reset &kp F11 &kp F4 &kp F5 &kp F6 &kp SCROLLLOCK &none &kp LEFT_SHIFT &kp LEFT_CONTROL &kp LEFT_ALT &kp LEFT_GUI &kp F10 &kp F1 &kp F2 &kp F3 &kp PAUSE_BREAK &none &none &none &kp RIGHT_ALT &none &kp K_APPLICATION &kp SPACE &kp TAB &none &none &none
          >;
        };
    };
};
  

*/