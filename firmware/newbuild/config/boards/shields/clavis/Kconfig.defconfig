## firmware/newbuild/config/boards/shields/clavis/Kconfig.defconfig
```kconfig
if SHIELD_CLAVIS_DONGLE
config ZMK_KEYBOARD_NAME
    default "clavis"

config ZMK_SPLIT_ROLE_CENTRAL
    default y

config ZMK_USB
    default y
endif

if SHIELD_CLAVIS_LEFT || SHIELD_CLAVIS_RIGHT || SHIELD_CLAVIS_DONGLE
config ZMK_SPLIT
    default y

config ZMK_BLE
    default y
endif
```

## firmware/newbuild/config/boards/shields/clavis/Kconfig.shield
```kconfig
config SHIELD_CLAVIS_LEFT
	def_bool $(shields_list_contains,clavis_left)

config SHIELD_CLAVIS_RIGHT
	def_bool $(shields_list_contains,clavis_right)

config SHIELD_CLAVIS_DONGLE
    def_bool $(shields_list_contains,clavis_dongle)
```
